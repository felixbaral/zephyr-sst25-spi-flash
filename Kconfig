## Kconfig
```kconfig
menuconfig SST25
	bool "microchip SST25 family of SPI-flashs"
	default n
	select SPI
	help
	  Enable driver for SST25 driver.

if SST25


endif
```

## dts/bindings/spi/microchip,sst25.yaml
```yaml
description: |
  This binding provides a raw SPI interface to the Microchip SST25 SPI-flash familiy.

compatible: "microchip,sst25"

include: [spi-device.yaml, "jedec,spi-nor-common.yaml"]

properties:
  wp-gpios:
    type: phandle-array
    description: WPn pin
  hold-gpios:
    type: phandle-array
    description: HOLDn pin
  reset-gpios:
    type: phandle-array
    description: RESETn pin
```
